/* Copyright (c) 2013, The Linux Foundation. All rights reserved.
 *
 * Panel: TD4310 1080p Video Mode (TXD variant)
 * Device: ASUS X00TD (Zenfone Max Pro M1)
 * Brightness: 450 nits | Backlight max: 4095
 * OVP-safe configuration
 */

&mdss_mdp {
	dsi_td4310_1080p_video_txd: qcom,mdss_dsi_td4310_1080p_video_txd {
		qcom,mdss-dsi-panel-name = "td4310 1080p video mode dsi txd panel";
		qcom,mdss-dsi-panel-controller = <&mdss_dsi0>;
		qcom,mdss-dsi-panel-type = "dsi_video_mode";
		qcom,mdss-dsi-panel-destination = "display_1";
		qcom,mdss-dsi-panel-framerate = <60>;
		qcom,mdss-dsi-virtual-channel-id = <0>;
		qcom,mdss-dsi-stream = <0>;

		qcom,mdss-dsi-panel-width = <1080>;
		qcom,mdss-dsi-panel-height = <2160>;
		qcom,mdss-pan-physical-width-dimension = <68>;
		qcom,mdss-pan-physical-height-dimension = <136>;
		qcom,mdss-dsi-bpp = <24>;

		qcom,mdss-dsi-h-front-porch = <102>;
		qcom,mdss-dsi-h-back-porch = <60>;
		qcom,mdss-dsi-h-pulse-width = <2>;
		qcom,mdss-dsi-h-sync-skew = <0>;
		qcom,mdss-dsi-v-back-porch = <33>;
		qcom,mdss-dsi-v-front-porch = <4>;
		qcom,mdss-dsi-v-pulse-width = <2>;
		qcom,mdss-dsi-h-left-border = <0>;
		qcom,mdss-dsi-h-right-border = <0>;
		qcom,mdss-dsi-v-top-border = <0>;
		qcom,mdss-dsi-v-bottom-border = <0>;

		qcom,mdss-dsi-color-order = "rgb_swap_rgb";
		qcom,mdss-dsi-underflow-color = <0xff>;
		qcom,mdss-dsi-border-color = <0>;
		qcom,mdss-dsi-h-sync-pulse = <1>;
		qcom,mdss-dsi-traffic-mode = "non_burst_sync_event";
		qcom,mdss-dsi-lane-map = "lane_map_0123";
		qcom,mdss-dsi-lane-0-state;
		qcom,mdss-dsi-lane-1-state;
		qcom,mdss-dsi-lane-2-state;
		qcom,mdss-dsi-lane-3-state;

		qcom,mdss-dsi-force-clock-lane-hs;
		qcom,mdss-dsi-tx-eot-append;
		qcom,mdss-dsi-bllp-eof-power-mode;
		qcom,mdss-dsi-bllp-power-mode;

		/* ULPS for suspend/resume */
		qcom,ulps-enabled;
		qcom,suspend-ulps-enabled;

		/* Stock PHY timings */
		qcom,mdss-dsi-panel-timings-phy-v2 = [
			25 1F 09 0A 06 03 04 A0
			25 1F 09 0A 06 03 04 A0
			25 1F 09 0A 06 03 04 A0
			25 1F 09 0A 06 03 04 A0
			25 1E 08 0A 06 03 04 A0
		];
		qcom,mdss-dsi-t-clk-post = <0x1E>;
		qcom,mdss-dsi-t-clk-pre = <0x38>;

		qcom,mdss-dsi-bl-pmic-control-type = "bl_ctrl_wled";
		qcom,mdss-dsi-bl-min-level = <1>;
		qcom,mdss-dsi-bl-max-level = <4095>;
		qcom,mdss-brightness-max-level = <255>;

		qcom,mdss-dsi-dma-trigger = "trigger_sw";
		qcom,mdss-dsi-mdp-trigger = "none";

		qcom,mdss-dsi-reset-sequence = <1 30>, <0 10>, <1 30>;
		qcom,mdss-dsi-lp11-init;
		qcom,mdss-dsi-post-init-delay = <1>;

		qcom,mdss-dsi-on-command-state = "dsi_lp_mode";
		qcom,mdss-dsi-off-command-state = "dsi_hs_mode";

		qcom,mdss-dsi-on-command = [
			29 01 00 00 00 00 02 B0 00
			29 01 00 00 00 00 02 D6 01
			29 01 00 00 00 00 27 C7 06 1C 2B 3E 4E 5A 73 83 90 9C 4E 5A 68 7C 85 90 9E A9 B2 06 1B 2A 3D 4D 59 72 83 90 9C 4E 5A 68 7C 85 90 9E A9 B2
			29 01 00 00 00 00 14 C8 01 00 FC 01 02 FC 00 00 FD 01 FF FC 00 00 FE FA F8 FC 00
			29 01 00 00 00 00 04 F3 02 00 B4
			29 01 00 00 00 00 02 D6 01
			15 01 00 00 00 00 02 51 FF
			15 01 00 00 00 00 02 53 0C
			15 01 00 00 00 00 02 55 00
			15 01 00 00 00 00 02 36 00
			05 01 00 00 96 00 02 11 00
			05 01 00 00 50 00 02 29 00
		];

		qcom,mdss-dsi-off-command = [
			05 01 00 00 32 00 02 28 00
			05 01 00 00 78 00 02 10 00
		];
	};
};