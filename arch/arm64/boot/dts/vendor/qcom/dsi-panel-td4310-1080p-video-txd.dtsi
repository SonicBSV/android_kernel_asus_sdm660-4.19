/* Copyright (c) 2013, The Linux Foundation. All rights reserved.
 *
 * This  program is free software; you can redistribute it and/or modify
 * it under the terms of the GNU General Public License version 2 and
 * only version 2 as published by the Free Software Foundation.
 *
 * This program is distributed in the hope that it will be useful,
 * but WITHOUT ANY WARRANTY; without even the implied warranty of
 * MERCHANTABILITY or FITNESS FOR A PARTICULAR PURPOSE.  See the
 * GNU General Public License for more details.
 */

/*---------------------------------------------------------------------------
 * This file is autogenerated file using gcdb parser. Please do not edit it.
 * Update input XML file to add a new entry or update variable in this file
 * VERSION = "1.0"
 *---------------------------------------------------------------------------*/
&mdss_mdp {
	dsi_td4310_1080p_video_txd: qcom,mdss_dsi_td4310_1080p_video_txd {
		qcom,mdss-dsi-panel-name = "td4310 1080p video mode dsi txd panel";
		qcom,mdss-dsi-panel-controller = <&mdss_dsi0>;
		qcom,mdss-dsi-panel-type = "dsi_video_mode";
		qcom,mdss-dsi-panel-destination = "display_1";
		qcom,mdss-dsi-panel-framerate = <60>;
		qcom,mdss-dsi-virtual-channel-id = <0>;
		qcom,mdss-dsi-stream = <0>;
		qcom,mdss-dsi-panel-width = <1080>;
		qcom,mdss-dsi-panel-height = <2160>;
		qcom,mdss-pan-physical-width-dimension = <68>;
		qcom,mdss-pan-physical-height-dimension = <136>;
		qcom,mdss-dsi-h-front-porch = <102>;
		qcom,mdss-dsi-h-back-porch = <60>;
		qcom,mdss-dsi-h-pulse-width = <2>;
		qcom,mdss-dsi-h-sync-skew = <0>;
		qcom,mdss-dsi-v-back-porch = <33>;
		qcom,mdss-dsi-v-front-porch = <4>;
		qcom,mdss-dsi-v-pulse-width = <2>;
		qcom,mdss-dsi-h-left-border = <0>;
		qcom,mdss-dsi-h-right-border = <0>;
		qcom,mdss-dsi-v-top-border = <0>;
		qcom,mdss-dsi-v-bottom-border = <0>;
		qcom,mdss-dsi-bpp = <24>;
		qcom,mdss-dsi-color-order = "rgb_swap_rgb";
		qcom,mdss-dsi-underflow-color = <0xff>;
		qcom,mdss-dsi-border-color = <0>;
		qcom,mdss-dsi-on-command = [29 01 00 00 00 00 02 B0 00
			29 01 00 00 00 00 02 D6 01
			29 01 00 00 00 00 27 C7 06 1C 2B 3E 4E 5A 73 83 90 9C 4E 5A 68 7C 85 90 9E A9 B2 06 1B 2A 3D 4D 59 72 83 90 9C 4E 5A 68 7C 85 90 9E A9 B2
			29 01 00 00 00 00 14 C8 01 00 FC 01 02 FC 00 00 FD 01 FF FC 00 00 FE FA F8 FC 00
			29 01 00 00 00 00 04 F3 02 00 B4
			29 01 00 00 00 00 02 D6 01
			/* Начальный уровень яркости = 0xFF (максимум 8-бит reg 0x51).
			 * TD4310 использует 8-бит регистр яркости.
			 * Реальное управление — через WLED (bl_ctrl_wled).
			 * При bl_ctrl_wled значение в 0x51 — только стартовый уровень. */
			15 01 00 00 00 00 02 51 FF
			/* BL control: 0x0C = BL_CTR=1, CABC off.
			 * TD4310: reg 0x53 бит[3]=1 включает BL через reg 0x51,
			 * биты[1:0]=00 = CABC off. Оригинальное значение сохранено. */
			15 01 00 00 00 00 02 53 0C
			/* CABC OFF: предотвращает конфликт авто-яркости панели
			 * с WLED-драйвером. TD4310 имеет собственный CABC-контроллер,
			 * который при активации конкурирует с WLED за управление током,
			 * вызывая просадки и гашение при резком росте яркости. */
			15 01 00 00 00 00 02 55 00
			15 01 00 00 00 00 02 36 00
			/* Sleep Out с задержкой 150ms (0x96 = 150 десятичных, в 10ms единицах).
			 * TD4310 (TDDI = Touch+Display Driver IC) требует увеличенную
			 * паузу после Sleep Out для инициализации touch-подсистемы. */
			05 01 00 00 96 00 02 11 00
			05 01 00 00 50 00 02 29 00];
		qcom,mdss-dsi-off-command = [05 01 00 00 32 00 02 28 00
					05 01 00 00 78 00 02 10 00];
		qcom,mdss-dsi-esd-recover-command = [39 01 00 00 00 00 02 4F 01];
		qcom,mdss-dsi-on-command-state = "dsi_lp_mode";
		/* TD4310: off-команды в HS режиме (оригинал сохранён).
		 * Display Off и Sleep In отправляются в HS, т.к. панель
		 * может не принимать LP-команды в процессе shutdown. */
		qcom,mdss-dsi-off-command-state = "dsi_hs_mode";
		qcom,mdss-dsi-esd-recover-command-state = "dsi_lp_mode";
		qcom,mdss-dsi-h-sync-pulse = <1>;
		/* non_burst_sync_event: TD4310 требует sync-event режим,
		 * burst mode не поддерживается этим TDDI-контроллером. */
		qcom,mdss-dsi-traffic-mode = "non_burst_sync_event";
		qcom,mdss-dsi-lane-map = "lane_map_0123";
		qcom,mdss-dsi-bllp-eof-power-mode;
		qcom,mdss-dsi-bllp-power-mode;
		qcom,mdss-dsi-lane-0-state;
		qcom,mdss-dsi-lane-1-state;
		qcom,mdss-dsi-lane-2-state;
		qcom,mdss-dsi-lane-3-state;

		/* Держать clock lane в HS постоянно.
		 * TD4310 (TDDI, IPS, non_burst): в sync-event режиме
		 * переход clock в LP особенно критичен — панель теряет
		 * синхронизацию и гаснет при пиковой яркости. */
		qcom,mdss-dsi-force-clock-lane-hs;

		/* Запрет ULPS.
		 * TD4310 на SDM636: TDDI-контроллер объединяет touch и display,
		 * выход из ULPS прерывает touch-scan и вызывает просадку
		 * питания → кратковременное гашение дисплея. */
		qcom,ulps-enabled = <0>;

		qcom,mdss-dsi-panel-timings-phy-v2 = [25 1F 09 0A 06 03 04 a0
		25 1F 09 0A 06 03 04 a0
		25 1F 09 0A 06 03 04 a0
		25 1F 09 0A 06 03 04 a0
		25 1E 08 0A 06 03 04 a0];
		qcom,mdss-dsi-t-clk-post = <0x1E>;
		qcom,mdss-dsi-t-clk-pre = <0x38>;

		/* min=12: снижает бросок тока WLED при старте/смене яркости.
		 * max=4095: 12-бит диапазон для линейного ползунка в Android 11.
		 * Примечание: TD4310 reg 0x51 — 8-бит, WLED управляет независимо. */
		qcom,mdss-dsi-bl-min-level = <12>;
		qcom,mdss-dsi-bl-max-level = <4095>;

		qcom,mdss-dsi-dma-trigger = "trigger_sw";
		qcom,mdss-dsi-mdp-trigger = "none";
		qcom,mdss-dsi-bl-pmic-control-type = "bl_ctrl_wled";

		/* Сброс с увеличенной паузой RST↑=50ms.
		 * TD4310 (TDDI): объединённый touch+display контроллер
		 * требует больше времени на инициализацию обоих блоков
		 * после аппаратного сброса. */
		qcom,mdss-dsi-reset-sequence = <1 20>, <0 20>, <1 50>;

		/* LP11 обязателен: TD4310 в TDDI-режиме ждёт LP11
		 * как сигнал готовности хоста перед откликом. */
		qcom,mdss-dsi-lp11-init;

		/* 15ms: TD4310 (TDDI) требует время для инициализации
		 * как display, так и touch-части после reset. */
		qcom,mdss-dsi-init-delay-us = <15000>;

		/* ESD отключён: на Android 11 + kernel 4.4 вызывает
		 * ложные перезапуски. TD4310 в non_burst режиме особенно
		 * чувствителен к read-командам под нагрузкой DSI шины. */
		/* qcom,esd-check-enabled; */

		qcom,mdss-dsi-panel-status-command = [06 01 00 01 05 00 01 0A];
		qcom,mdss-dsi-panel-status-command-mode = "dsi_hs_mode";
		qcom,mdss-dsi-panel-status-check-mode = "reg_read";
		qcom,mdss-dsi-panel-status-read-length = <1>;
		qcom,mdss-dsi-panel-status-value = <0x1C>;
		qcom,mdss-dsi-panel-max-error-count = <5>;
	};
};
