/* Copyright (c) 2013, The Linux Foundation. All rights reserved.
 *
 * Panel: HX83112A 1080p Video Mode (TM)
 * Device: ASUS X01BD (Zenfone Max Pro M2)
 * Kernel: 4.19.325 | Android 16
 * Optimized for mdss 4.19
 */

&mdss_mdp {
	dsi_hx83112a_1080p_video_tm: qcom,mdss_dsi_hx83112a_1080p_video_tm {
		qcom,mdss-dsi-panel-name = "hx83112a 1080p video mode dsi tm panel";
		qcom,mdss-dsi-panel-controller = <&mdss_dsi0>;
		qcom,mdss-dsi-panel-type = "dsi_video_mode";
		qcom,mdss-dsi-panel-destination = "display_1";
		qcom,mdss-dsi-panel-framerate = <60>;
		qcom,mdss-dsi-virtual-channel-id = <0>;
		qcom,mdss-dsi-stream = <0>;

		qcom,mdss-dsi-panel-width = <1080>;
		qcom,mdss-dsi-panel-height = <2280>;
		qcom,mdss-pan-physical-width-dimension = <68>;
		qcom,mdss-pan-physical-height-dimension = <143>;
		qcom,mdss-dsi-bpp = <24>;

		qcom,mdss-dsi-h-front-porch = <120>;
		qcom,mdss-dsi-h-back-porch = <60>;
		qcom,mdss-dsi-h-pulse-width = <56>;
		qcom,mdss-dsi-h-sync-skew = <0>;
		qcom,mdss-dsi-v-back-porch = <10>;
		qcom,mdss-dsi-v-front-porch = <27>;
		qcom,mdss-dsi-v-pulse-width = <5>;
		qcom,mdss-dsi-h-left-border = <0>;
		qcom,mdss-dsi-h-right-border = <0>;
		qcom,mdss-dsi-v-top-border = <0>;
		qcom,mdss-dsi-v-bottom-border = <0>;

		qcom,mdss-dsi-color-order = "rgb_swap_rgb";
		qcom,mdss-dsi-underflow-color = <0xff>;
		qcom,mdss-dsi-border-color = <0>;
		qcom,mdss-dsi-h-sync-pulse = <1>;
		qcom,mdss-dsi-traffic-mode = "burst_mode";
		qcom,mdss-dsi-lane-map = "lane_map_0123";
		qcom,mdss-dsi-lane-0-state;
		qcom,mdss-dsi-lane-1-state;
		qcom,mdss-dsi-lane-2-state;
		qcom,mdss-dsi-lane-3-state;

		/* Stable output + proper resume */
		qcom,mdss-dsi-force-clock-lane-hs;
		qcom,mdss-dsi-tx-eot-append;
		qcom,mdss-dsi-bllp-eof-power-mode;
		qcom,mdss-dsi-bllp-power-mode;

		/* ULPS for suspend/resume */
		qcom,ulps-enabled;
		qcom,suspend-ulps-enabled;

		/* Stock PHY timings from 4.4 */
		qcom,mdss-dsi-panel-timings-phy-v2 = [
			26 21 09 0B 06 03 04 A0
			26 21 09 0B 06 03 04 A0
			26 21 09 0B 06 03 04 A0
			26 21 09 0B 06 03 04 A0
			26 20 0A 0B 06 03 04 A0
		];
		qcom,mdss-dsi-t-clk-post = <0x0F>;
		qcom,mdss-dsi-t-clk-pre = <0x37>;

		qcom,mdss-dsi-bl-pmic-control-type = "bl_ctrl_wled";
		qcom,mdss-dsi-bl-min-level = <1>;
		qcom,mdss-dsi-bl-max-level = <4095>;
		qcom,mdss-brightness-max-level = <255>;

		qcom,mdss-dsi-dma-trigger = "trigger_sw";
		qcom,mdss-dsi-mdp-trigger = "none";

		/* Stock reset + init delay */
		qcom,mdss-dsi-reset-sequence = <1 10>, <0 10>, <1 20>;
		qcom,mdss-dsi-lp11-init;
		qcom,mdss-dsi-init-delay-us = <30000>;
		qcom,mdss-dsi-post-init-delay = <1>;

		qcom,mdss-dsi-on-command-state = "dsi_lp_mode";
		qcom,mdss-dsi-off-command-state = "dsi_lp_mode";

		qcom,mdss-dsi-on-command = [
			39 01 00 00 00 00 04 B9 83 11 2A
			15 01 00 00 00 00 02 E9 C3
			39 01 00 00 00 00 03 CB C1 D1
			15 01 00 00 00 00 02 E9 3F
			15 01 00 00 00 00 02 E9 C3
			39 01 00 00 00 00 03 CB D1 D1
			15 01 00 00 00 00 02 E9 3F
			15 01 00 00 00 00 02 E9 C7
			39 01 00 00 00 00 04 B2 0D 19 E9
			15 01 00 00 00 00 02 E9 3F
			39 01 00 00 00 00 07 E7 0E 0E 1E 65 1C 65
			15 01 00 00 00 00 02 E9 C8
			39 01 00 00 00 00 06 B4 BA 08 BA 00 BF
			15 01 00 00 00 00 02 E9 3F
			15 01 00 00 00 00 02 E9 C4
			15 01 00 00 00 00 02 CF C0
			15 01 00 00 00 00 02 E9 3F
			39 01 00 00 00 00 03 51 0F FF
			15 01 00 00 00 00 02 53 2C
			05 01 00 00 50 00 01 11
			15 01 00 00 00 00 02 35 00
			39 01 00 00 00 00 03 BA 73 23
			39 01 00 00 00 00 04 B9 00 00 00
			05 01 00 00 14 00 01 29
		];

		qcom,mdss-dsi-off-command = [
			05 01 00 00 32 00 02 28 00
			05 01 00 00 78 00 02 10 00
		];
	};
};